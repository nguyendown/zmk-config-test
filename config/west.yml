## config/west.yml
```yaml
manifest:
  remotes:
    - name: zmkfirmware
      url-base: https://github.com/zmkfirmware
    - name: nguyendown
      url-base: https://github.com/nguyendown
  projects:
    - name: zmk
      remote: nguyendown
      revision: bongo-test
      import: app/west.yml
  self:
    path: config
```
